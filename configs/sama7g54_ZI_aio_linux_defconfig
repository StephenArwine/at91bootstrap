## configs/sama7g54_som2g_ZI_defconfig
```kconfig
# Copyright (C) 2025 Microchip Technology Inc. and its subsidiaries
#
# SPDX-License-Identifier: MIT

CONFIG_SAMA7G5=y
CONFIG_CPU_CLK_800MHZ=y
CONFIG_DEBUG=y
CONFIG_DDR_SET_BY_DEVICE=y
CONFIG_DDR_W632GU6NB12I=y
CONFIG_MEM_CLOCK_533=y
CONFIG_SPI_CLK=133333334
CONFIG_QSPI_BUS=1
CONFIG_QSPI_DMA_SUPPORT=y
CONFIG_IMG_ADDRESS="0x00040000"
CONFIG_JUMP_ADDR="0x66f00000"
CONFIG_IMG_SIZE="0x000c0000"
CONFIG_NANDFLASH=y
# CONFIG_REDIRECT_ALL_INTS_AIC is not set
CONFIG_TZC400=y
CONFIG_FLEXCOM10=y
CONFIG_FLEXCOM10_IOSET=2
CONFIG_MCP16502=y
CONFIG_MCP16502_SET_VOLTAGE=y
CONFIG_VOLTAGE_OUT4=1150
CONFIG_WDTS=y
```

## configs/sama7g54_som2g_ZI_fb_defconfig
```kconfig
# Copyright (C) 2025 Microchip Technology Inc. and its subsidiaries
#
# SPDX-License-Identifier: MIT

CONFIG_SAMA7G5=y
CONFIG_CPU_CLK_800MHZ=y
CONFIG_DEBUG=y
CONFIG_DDR_SET_BY_DEVICE=y
CONFIG_DDR_W632GU6NB12I=y
CONFIG_MEM_CLOCK_533=y
CONFIG_SPI_CLK=133333334
CONFIG_QSPI_BUS=1
CONFIG_QSPI_DMA_SUPPORT=y
CONFIG_IMG_ADDRESS="0x00040000"
CONFIG_JUMP_ADDR="0x66f00000"
CONFIG_IMG_SIZE="0x000c0000"
CONFIG_NANDFLASH=y
CONFIG_NAND_TIMING_MODE=y
CONFIG_NAND_DMA_SUPPORT=y
# CONFIG_REDIRECT_ALL_INTS_AIC is not set
CONFIG_TZC400=y
CONFIG_BACKUP_MODE=y
CONFIG_SHDWC=y
CONFIG_FAST_BOOT=y
CONFIG_FASTBOOT_MEM_MAP_ADDRESS=0xcfdd9000
CONFIG_FASTBOOT_MAX_NB_MEM_MAP=0x10000
CONFIG_FASTBOOT_SIZEOF_PAGE_STRU=0x20
CONFIG_FASTBOOT_OFFSET_OF_PAGETYPE=0x18
CONFIG_FASTBOOT_OFFSET_OF_PRIVATE=0x14
CONFIG_FASTBOOT_IMG_ADDRESS=0x10000000
CONFIG_FLEXCOM10=y
CONFIG_FLEXCOM10_IOSET=2
CONFIG_MCP16502=y
CONFIG_MCP16502_SET_VOLTAGE=y
CONFIG_VOLTAGE_OUT4=1150
CONFIG_WDTS=y
```

## configs/sama7g54_som2g_ZI_linux_defconfig
```kconfig
# Copyright (C) 2025 Microchip Technology Inc. and its subsidiaries
#
# SPDX-License-Identifier: MIT

CONFIG_SAMA7G5=y
CONFIG_CPU_CLK_800MHZ=y
CONFIG_DDR_SET_BY_DEVICE=y
CONFIG_DDR_W632GU6NB12I=y
CONFIG_MEM_CLOCK_533=y
CONFIG_DEBUG=y
CONFIG_NANDFLASH=y
# CONFIG_NAND_TIMING_MODE is not set
# CONFIG_NAND_DMA_SUPPORT is not set
CONFIG_LOAD_LINUX=y
CONFIG_OVERRIDE_CMDLINE=y
CONFIG_LINUX_KERNEL_ARG_STRING="CONFIG_ARG_CONSOLE CONFIG_ARG_MTD CONFIG_ARG_ROOT CONFIG_ARG_ROOTFSTYPE CONFIG_ARG_RW CONFIG_ARG_ROOTWAIT"
CONFIG_ARG_CONSOLE="earlycon console=ttyS0,115200"
CONFIG_ARG_MTD=" mtdparts=atmel_nand:256k(reserved0),1M(uboot),256k(reserved1),512k(dtb),6M(kernel),-(rootfs)"
CONFIG_ARG_ROOT=" ubi.block=0,rootfs_a root=/dev/ubiblock0_0"
CONFIG_ARG_ROOTFSTYPE=" rootfstype=squashfs ubi.mtd=rootfs"
CONFIG_ARG_RW=" ro"
CONFIG_ARG_ROOTWAIT=" rootwait"
CONFIG_IMAGE_NAME="zImage"
# CONFIG_REDIRECT_ALL_INTS_AIC is not set
CONFIG_TZC400=y
CONFIG_FLEXCOM10=y
CONFIG_FLEXCOM10_IOSET=2
CONFIG_MCP16502=y
CONFIG_MCP16502_SET_VOLTAGE=y
CONFIG_VOLTAGE_OUT4=1150
CONFIG_WDTS=y
```
